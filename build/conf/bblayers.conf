## build/conf/bblayers.conf
```bitbake
# POKY_BBLAYERS_CONF_VERSION is increased each time build/conf/bblayers.conf
# changes incompatibly
POKY_BBLAYERS_CONF_VERSION = "2"

BBPATH = "${TOPDIR}"
BBFILES ?= ""

BBLAYERS ?= " \
  /home/mahoonio/Desktop/yocto/alix2d/poky-amd-dunfell/meta \
  /home/mahoonio/Desktop/yocto/alix2d/poky-amd-dunfell/meta-poky \
  /home/mahoonio/Desktop/yocto/alix2d/poky-amd-dunfell/meta-yocto-bsp \
  /home/mahoonio/Desktop/yocto/alix2d/poky-amd-dunfell/meta-geode \
  /home/mahoonio/Desktop/yocto/alix2d/poky-amd-dunfell/meta-openembedded/meta-oe \
  /home/mahoonio/Desktop/yocto/alix2d/poky-amd-dunfell/meta-openembedded/meta-python \
  /home/mahoonio/Desktop/yocto/alix2d/poky-amd-dunfell/meta-openembedded/meta-networking \
  /home/mahoonio/Desktop/yocto/alix2d/poky-amd-dunfell/meta-dpdk \
  /home/mahoonio/Desktop/yocto/alix2d/poky-amd-dunfell/meta-amd/meta-amd-distro \
  /home/mahoonio/Desktop/yocto/alix2d/poky-amd-dunfell/meta-amd/meta-amd-bsp \
  "
```

## meta-geode/conf/layer.conf
```bitbake
# We have a conf and classes directory, add to BBPATH
BBPATH .= ":${LAYERDIR}"

# We have recipes-* directories, add to BBFILES
BBFILES += "${LAYERDIR}/recipes-*/*/*.bb \
            ${LAYERDIR}/recipes-*/*/*.bbappend"

BBFILE_COLLECTIONS += "meta-geode"
BBFILE_PATTERN_meta-geode = "^${LAYERDIR}/"
BBFILE_PRIORITY_meta-geode = "6"

LAYERDEPENDS_meta-geode = "core"
LAYERSERIES_COMPAT_meta-geode = "dunfell"
```

## vscode-bitbake-build/conf/bblayers.conf
```bitbake
# POKY_BBLAYERS_CONF_VERSION is increased each time build/conf/bblayers.conf
# changes incompatibly
POKY_BBLAYERS_CONF_VERSION = "2"

BBPATH = "${TOPDIR}"
BBFILES ?= ""

BBLAYERS ?= " \
  /home/mahoonio/Desktop/yocto/alix2d/poky-amd-dunfell/meta \
  /home/mahoonio/Desktop/yocto/alix2d/poky-amd-dunfell/meta-poky \
  /home/mahoonio/Desktop/yocto/alix2d/poky-amd-dunfell/meta-yocto-bsp \
  "
```
